## boards/shields/corne_ulp_ball/Kconfig.defconfig
```kconfig
# if SHIELD_CORNE_ULP_BALL_LEFT && ZMK_SPLIT_ROLE_CENTRAL

# config ZMK_KEYBOARD_NAME
#     default "Corne ULP Ball"

# config ZMK_SPLIT_ROLE_CENTRAL
#     default y

# config ZMK_STUDIO
#     default y

# endif # SHIELD_CORNE_ULP_BALL_LEFT


if SHIELD_CORNE_ULP_BALL_LEFT || SHIELD_CORNE_ULP_BALL_RIGHT

config ZMK_SPLIT
    default y

config SPI
    default y

config ZMK_POINTING
    default y

config AZ1UBALL
    default y

config I2C
    default y

config ZMK_SPLIT_BLE_ROLE_PERIPHERAL
    default y

config ZMK_SPLIT_BLE_PERIPHERAL_INPUT
    default y

endif # SHIELD_CORNE_ULP_BALL_LEFT || SHIELD_CORNE_ULP_BALL_RIGHT

if SHIELD_CORNE_ULP_BALL_DONGLE

# Max 16 characters in keyboard name
config ZMK_KEYBOARD_NAME
    default "Corne ULP Ball"

config ZMK_SPLIT_ROLE_CENTRAL
    default y

config ZMK_SPLIT
    default y

# Set this to the number of peripherals your dongle will have.
# For a unibody, this would be 1. If you have left and right halves, set it to 2, etc.
config ZMK_SPLIT_BLE_CENTRAL_PERIPHERALS
    default 2

# Set this to ZMK_SPLIT_BLE_CENTRAL_PERIPHERALS + your desired number of BT profiles (default is 5)
config BT_MAX_CONN
    default 5

# Set this to the same number as BT_MAX_CONN
config BT_MAX_PAIRED
    default 5

endif
```

## boards/shields/corne_ulp_ball/Kconfig.shield
```kconfig
config SHIELD_CORNE_ULP_BALL_LEFT
    def_bool $(shields_list_contains,corne_ulp_ball_left)

config SHIELD_CORNE_ULP_BALL_RIGHT
    def_bool $(shields_list_contains,corne_ulp_ball_right)

# No whitespace after the comma or in the keyboard name!
config SHIELD_CORNE_ULP_BALL_DONGLE
    def_bool $(shields_list_contains,corne_ulp_ball_dongle)
```
